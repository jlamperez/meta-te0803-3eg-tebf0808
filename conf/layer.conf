## conf/layer.conf
```bitbake
# We have a conf and classes directory, add to BBPATH
BBPATH .= ":${LAYERDIR}"

# We have recipes-* directories, add to BBFILES
BBFILES += "${LAYERDIR}/recipes-*/*/*.bb \
	${LAYERDIR}/recipes-*/*/*.bbappend"

BBFILE_COLLECTIONS += "te0803"
BBFILE_PATTERN_te0803 = "^${LAYERDIR}/"
BBFILE_PRIORITY_te0803 = "6"
```

## conf/machine/te0803-3eg-tebf0808-zynqmp.conf
```bitbake
#@TYPE: Machine
#@NAME: te0803-3eg-tebf0808-zynqmp
#@DESCRIPTION: Machine support for TE0803-3eg and TEBF0808 Carrier board.

SOC_VARIANT ?= "eg"

require conf/machine/include/tune-zynqmp.inc
require conf/machine/include/machine-xilinx-board.inc
require conf/machine/include/machine-xilinx-default.inc
require conf/machine/include/machine-xilinx-board.inc
include conf/machine/include/zynqmp-pmu-config.inc

MACHINE_EXTRA_RRECOMMENDS += " kernel-modules"

MACHINE_FEATURES = "rtc ext2 ext3 vfat usbhost"

UBOOT_MACHINE = "te0803-3eg-tebf0808-zynqmp_defconfig"
SPL_BINARY = "spl/boot.bin"

SERIAL_CONSOLE= "115200 ttyPS0"

SERIAL_CONSOLES_CHECK = "${SERIAL_CONSOLES}"

#KERNEL_DEVICETREE = ""

PREFERRED_PROVIDER_virtual/kernel = "linux-xlnx"
PREFERRED_PROVIDER_virtual/bootloader = "u-boot-xlnx"
PREFERRED_PROVIDER_virtual/pmu-firmware ?= "zynqmp-pmu-pmu-firmware"
#PREFERRED_PROVIDER_virtual/dtb = "device-tree-generation"
#PREFERRED_PROVIDER_virtual/hdf = "external-hdf"
#PREFERRED_PROVIDER_virtual/bitstream = "bitstream-extraction"
#PREFERRED_PROVIDER_virtual/libgles1 = "libmali-xlnx"
#PREFERRED_PROVIDER_virtual/libgles2 = "libmali-xlnx"
#PREFERRED_PROVIDER_virtual/egl = "libmali-xlnx"
#PREFERRED_PROVIDER_virtual/libgl = "libmali-xlnx"
#PREFERRED_PROVIDER_virtual/libgl = "mesa-gl"
#PREFERRED_PROVIDER_virtual/mesa = "mesa-gl"
#PREFERRED_PROVIDER_virtual/libgbm = "mesa"
#PREFERRED_PROVIDER_virtual/fsbl = "fsbl"
#PREFERRED_PROVIDER_virtual/pmufw = "pmu-firmware"
#PREFERRED_PROVIDER_virtual/arm-trusted-firmware = "arm-trusted-firmware"

#EXTRA_IMAGEDEPENDS += "device-tree-generation \
#                       pmu-firmware \
#                       arm-trusted-firmware \
#                       "
EXTRA_IMAGEDEPENDS += " \
                u-boot-zynq-uenv \
                arm-trusted-firmware \
                virtual/pmu-firmware \
                virtual/boot-bin \
                "
IMAGE_BOOT_FILES += "uEnv.txt atf-uboot.ub ${KERNEL_IMAGETYPE}-te0803-3eg-tebf0808-zynqmp.dtb"
```
